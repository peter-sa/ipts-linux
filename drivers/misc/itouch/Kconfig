## drivers/misc/itouch/Kconfig
```kconfig
config INTEL_MEI_ITOUCH
	tristate "Intel Integrated Touch with ME Interface"
	select INTEL_MEI_ME
	depends on X86 && PCI && DRM_I915 && HID
	help
	  MEI Support for Intel Integrated Touch device on Intel SoCs
	  Supported SoCs:
	  Intel Skylake
```
